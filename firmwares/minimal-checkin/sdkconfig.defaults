## firmwares/minimal-checkin/sdkconfig.defaults
```kconfig
# --- 目标芯片 ---
CONFIG_IDF_TARGET="esp32c3"
# ESP32-C3 无 PSRAM

# --- Flash 8MB ---
CONFIG_ESPTOOLPY_FLASHSIZE_8MB=y
CONFIG_ESPTOOLPY_HEADER_FLASHSIZE_UPDATE=n
CONFIG_PARTITION_TABLE_CUSTOM=y
CONFIG_PARTITION_TABLE_CUSTOM_FILENAME="partitions.csv"
CONFIG_PARTITION_TABLE_FILENAME="partitions.csv"

# --- 控制台:USB-Serial-JTAG(C3 原生 USB) ---
CONFIG_ESP_CONSOLE_USB_SERIAL_JTAG=y
CONFIG_ESP_CONSOLE_SECONDARY_NONE=y

# --- LVGL ---
CONFIG_LV_COLOR_DEPTH_16=y
CONFIG_LV_DEF_REFR_PERIOD=20
# 内置字体:16 供 WiFi 符号与徽章符号,48 供时钟
CONFIG_LV_FONT_MONTSERRAT_16=y
CONFIG_LV_FONT_MONTSERRAT_48=y
# GB2312 全量字体位图超 64KB，需要 LVGL 大字体格式
CONFIG_LV_FONT_FMT_TXT_LARGE=y
# 大日数字 96px 为自定义字体 font_day_96（tools/gen_font_day.mjs 生成）
# LVGL 内置 malloc 池(字节):本固件页面较复杂(动画/月历/二维码),给 48KB
CONFIG_LV_MEM_SIZE=49152

# --- 系统 ---
CONFIG_FREERTOS_HZ=1000

# --- 不用蓝牙(省 flash/RAM,配网走 SoftAP 扫码) ---
CONFIG_BT_ENABLED=n
```
